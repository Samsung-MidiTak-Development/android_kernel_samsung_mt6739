## drivers/input/touchscreen/synaptics/td4150_a01core/Kconfig
```kconfig
#
# Synaptics TCM touchscreen driver configuration
#
menuconfig TOUCHSCREEN_SYNAPTICS_TCM_A01CORE
	bool "Synaptics TCM touchscreen"
	default n
	help
	  Say Y here if you have a Synaptics TCM touchscreen connected
	  to your system.

	  If unsure, say N.

if TOUCHSCREEN_SYNAPTICS_TCM_A01CORE

choice
	default TOUCHSCREEN_SYNAPTICS_TCM_I2C_A01CORE
	prompt "Synaptics TCM bus module"
config TOUCHSCREEN_SYNAPTICS_TCM_I2C_A01CORE
	bool "I2C"
	depends on I2C
config TOUCHSCREEN_SYNAPTICS_TCM_SPI_A01CORE
	bool "SPI"
	depends on SPI_MASTER
endchoice

config TOUCHSCREEN_SYNAPTICS_TCM_CORE_A01CORE
	tristate "Synaptics TCM core module"
	depends on I2C || SPI_MASTER
	help
	  Say Y here to enable core functionality.

	  If unsure, say N.

	  To compile this driver as a module, choose M here: the
	  module will be called synaptics_tcm_core.

config TOUCHSCREEN_SYNAPTICS_TCM_DEVICE_A01CORE
	tristate "Synaptics TCM device module"
	depends on TOUCHSCREEN_SYNAPTICS_TCM_CORE_A01CORE
	help
	  Say Y here to enable support for TCM device functionality.

	  If unsure, say N.

	  To compile this driver as a module, choose M here: the
	  module will be called synaptics_tcm_device.

config TOUCHSCREEN_SYNAPTICS_TCM_TESTING_A01CORE
	tristate "Synaptics TCM testing module"
	depends on TOUCHSCREEN_SYNAPTICS_TCM_CORE_A01CORE
	help
	  Say Y here to enable support for testing functionality.

	  If unsure, say N.

	  To compile this driver as a module, choose M here: the
	  module will be called synaptics_tcm_testing.

config TOUCHSCREEN_SYNAPTICS_TCM_REFLASH_A01CORE
	tristate "Synaptics TCM reflash module"
	depends on TOUCHSCREEN_SYNAPTICS_TCM_CORE_A01CORE
	help
	  Say Y here to enable support for reflash functionality.

	  If unsure, say N.

	  To compile this driver as a module, choose M here: the
	  module will be called synaptics_tcm_reflash.

config TOUCHSCREEN_SYNAPTICS_TCM_RECOVERY_A01CORE
	tristate "Synaptics TCM recovery module"
	depends on TOUCHSCREEN_SYNAPTICS_TCM_CORE_A01CORE
	help
	  Say Y here to enable support for recovery functionality.

	  If unsure, say N.

	  To compile this driver as a module, choose M here: the
	  module will be called synaptics_tcm_recovery.

config TOUCHSCREEN_SYNAPTICS_TCM_ZEROFLASH_A01CORE
	tristate "Synaptics TCM zeroflash module"
	depends on TOUCHSCREEN_SYNAPTICS_TCM_CORE_A01CORE
	help
	  Say Y here to enable support for ZeroFlash functionality.

	  If unsure, say N.

	  To compile this driver as a module, choose M here: the
	  module will be called synaptics_tcm_zeroflash.

config TOUCHSCREEN_SYNAPTICS_TCM_DIAGNOSTICS_A01CORE
	tristate "Synaptics TCM diagnostics module"
	depends on TOUCHSCREEN_SYNAPTICS_TCM_CORE_A01CORE
	help
	  Say Y here to enable support for diagnostics functionality.

	  If unsure, say N.

	  To compile this driver as a module, choose M here: the
	  module will be called synaptics_tcm_diagnostics.

config TOUCHSCREEN_SYNAPTICS_TCM_SEC_FN_A01CORE
	tristate "Synaptics TCM samsung func module"
	depends on TOUCHSCREEN_SYNAPTICS_TCM_CORE_A01CORE
	help
	  Say Y here to enable support for diagnostics functionality.

	  If unsure, say N.

	  To compile this driver as a module, choose M here: the
	  module will be called synaptics_tcm_sec_fn.
endif
```
